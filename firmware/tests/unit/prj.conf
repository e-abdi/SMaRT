## CMakeLists.txt
```
# Unit and scenario tests on the host (native_sim), built against a real
# profile so the shipped configuration is what gets tested:
#
#   west build -b native_sim/native/64 firmware/tests/unit -- -DSMART_PROFILE=uvp6_slocum
#   build/zephyr/zephyr.exe
#
cmake_minimum_required(VERSION 3.20.0)

set(SMART_ROOT ${CMAKE_CURRENT_LIST_DIR}/../..)
if(NOT DEFINED SMART_PROFILE)
  set(SMART_PROFILE uvp6_slocum)
endif()
list(APPEND EXTRA_CONF_FILE ${SMART_ROOT}/profiles/${SMART_PROFILE}/smart.conf)
set(KCONFIG_ROOT ${SMART_ROOT}/Kconfig)

find_package(Zephyr REQUIRED HINTS $ENV{ZEPHYR_BASE})
project(smart_unit)

include(${SMART_ROOT}/smart.cmake)
target_sources(app PRIVATE
  src/fake_hw.c
  src/test_util.c
  src/test_scenario_slocum.c
  src/test_scenario_seaglider.c
)
```

## prj.conf
```kconfig
CONFIG_ZTEST=y
CONFIG_SMF=y
CONFIG_SMF_ANCESTOR_SUPPORT=y
CONFIG_SMF_INITIAL_TRANSITION=y
CONFIG_LOG=y
CONFIG_LOG_MODE_IMMEDIATE=y
CONFIG_SMART_LOG_LEVEL_INF=y
# Tests drive time explicitly; the watchdog is a board concern
CONFIG_SMART_WATCHDOG_TIMEOUT_MS=0
```

## src/fake_hw.c
```c
#include "fake_hw.h"

#include <string.h>
#include <zephyr/sys/util.h>

#include "core/app.h"
#include "core/board_io.h"
#include "util/nmea.h"

#define TX_CAP 16384

static char tx[PORT_NUM][TX_CAP];
static size_t tx_len[PORT_NUM];
static struct port_stats stats[PORT_NUM];
static bool powered;
int64_t t_now;

void fake_reset(void)
{
	memset(tx_len, 0, sizeof(tx_len));
	memset(stats, 0, sizeof(stats));
	tx[PORT_GLIDER][0] = tx[PORT_SENSOR][0] = '\0';
	powered = false;
	t_now = 0;
}

int port_init(void)
{
	return 0;
}

void port_wait_ms(int32_t ms)
{
	ARG_UNUSED(ms);
}

void port_write(enum smart_port port, const char *data, size_t len)
{
	size_t room = TX_CAP - 1 - tx_len[port];
	size_t n = len < room ? len : room;

	memcpy(&tx[port][tx_len[port]], data, n);
	tx_len[port] += n;
	tx[port][tx_len[port]] = '\0';
}

size_t port_read(enum smart_port port, uint8_t *buf, size_t cap)
{
	ARG_UNUSED(port);
	ARG_UNUSED(buf);
	ARG_UNUSED(cap);
	return 0;
}

void port_discard_rx(enum smart_port port)
{
	ARG_UNUSED(port);
}

const struct port_stats *port_get_stats(enum smart_port port)
{
	return &stats[port];
}

int board_io_init(void)
{
	return 0;
}

void sensor_power_set(bool on)
{
	powered = on;
}

void board_watchdog_feed(void)
{
}

const char *fake_tx(enum smart_port port)
{
	return tx[port];
}

void fake_tx_clear(void)
{
	memset(tx_len, 0, sizeof(tx_len));
	tx[PORT_GLIDER][0] = tx[PORT_SENSOR][0] = '\0';
}

bool fake_sensor_powered(void)
{
	return powered;
}

int fake_count(enum smart_port port, const char *needle)
{
	int n = 0;
	size_t len = strlen(needle);

	for (const char *p = tx[port]; (p = strstr(p, needle)) != NULL; p += len) {
		n++;
	}
	return n;
}

void glider_says(const char *text)
{
	app_feed(PORT_GLIDER, (const uint8_t *)text, strlen(text), t_now);
}

void glider_nmea(const char *payload)
{
	glider_says(nmea_of(payload));
}

void sensor_says(const char *text)
{
	app_feed(PORT_SENSOR, (const uint8_t *)text, strlen(text), t_now);
}

void advance_ms(int ms)
{
	for (int i = 0; i < ms; i += 10) {
		t_now += 10;
		app_poll(t_now);
	}
}

const char *nmea_of(const char *payload)
{
	static char buf[4][256];
	static int slot;
	char *out = buf[slot++ % 4];

	nmea_build(out, sizeof(buf[0]), payload);
	return out;
}
```

## src/fake_hw.h
```c
/* Test doubles for the serial ports and board I/O, plus scenario helpers. */
#pragma once

#include <stdbool.h>
#include <stdint.h>

#include "core/port.h"

extern int64_t t_now;

void fake_reset(void);
const char *fake_tx(enum smart_port port);
void fake_tx_clear(void);
bool fake_sensor_powered(void);
int fake_count(enum smart_port port, const char *needle);

/* Scenario helpers: send text into a port, advance time in 10 ms steps */
void glider_says(const char *text);
void glider_nmea(const char *payload);
void sensor_says(const char *text);
void advance_ms(int ms);
/* The exact NMEA frame for payload, e.g. "SW,0:3" -> "$SW,0:3*0F\r\n" */
const char *nmea_of(const char *payload);
```

## src/test_scenario_seaglider.c
```c
/*
 * End-to-end scenarios for the uvp6_seaglider profile: the board acting as a
 * logdev logger device (uvp6.cnf) in front of a UVP6.
 */
#ifdef CONFIG_SMART_GLIDER_SEAGLIDER

#include <stdio.h>
#include <string.h>
#include <zephyr/ztest.h>

#include "core/app.h"
#include "core/controller.h"
#include "fake_hw.h"

#define PROMPT "UV>\r"

static void before(void *f)
{
	ARG_UNUSED(f);
	fake_reset();
	app_init(0);
}

ZTEST_SUITE(seaglider, NULL, NULL, before, NULL, NULL);

static int prompts(void)
{
	return fake_count(PORT_GLIDER, PROMPT);
}

static void lpm(int i)
{
	char line[200];

	snprintf(line, sizeof(line),
		 "LPM_DATA,%d.0,20260601,1200%02d,10,4.5,"
		 "1,1,1,1,2,2,2,2,3,3,3,3,4,4,4,4,5,5,"
		 "0,0,0,0,0,0,0,0,0,0,0,0,0,0,0,0;\n",
		 i, i);
	sensor_says(line);
}

ZTEST(seaglider, test_dive_and_download)
{
	sensor_says("HW_CONF,000001,UVP6\n");
	zassert_equal(prompts(), 1, "prompt for powerup-timeout");

	glider_says("\r");
	zassert_equal(prompts(), 2, "wakeup answered");

	glider_says("START 20260601,120000,1\r");
	zassert_equal(prompts(), 3, "start answered at once");
	zassert_not_null(strstr(fake_tx(PORT_SENSOR), "$start:ACQ_CSCS_022H,20260601,120000;\n"));
	sensor_says("$startack;\n");
	zassert_equal(controller_state(), ST_SAMPLING);

	glider_says("DEPTH:12.5\r");
	zassert_equal(prompts(), 3, "status= gets no reply");

	for (int i = 0; i <= 10; i++) {
		lpm(i);
	}

	glider_says("STOP\r");
	zassert_equal(controller_state(), ST_STOPPING);
	zassert_equal(prompts(), 3, "prompt only once stopped");
	sensor_says("$stopack;\n");
	zassert_equal(prompts(), 4);

	fake_tx_clear();
	glider_says("SEND_TXT_FILE 1\r");
	const char *out = fake_tx(PORT_GLIDER);

	zassert_not_null(strstr(out, "LPM,0.0,20260601,120000,4,8,12,16,10\r\n"), "got %s", out);
	zassert_not_null(strstr(out, "LPM,10.0,20260601,120010,4,8,12,16,10\r\n"));
	zassert_equal(fake_count(PORT_GLIDER, "LPM,"), 2, "decimated 1 in 10");
	zassert_not_null(strstr(out, "#SEG,1,dive,11,10.00,10.00,"));
	zassert_equal(strcmp(out + strlen(out) - strlen(PROMPT), PROMPT), 0, "ends with prompt");

	/* Climb cast: the dive data stays until a new dive cast starts. The
	 * sensor is restarted once the stop/start holdoff has passed.
	 */
	glider_says("START 20260601,130000,2\r");
	zassert_equal(controller_state(), ST_HOLDOFF);
	advance_ms(CONFIG_SMART_POLICY_RESTART_HOLDOFF_MS);
	zassert_equal(controller_state(), ST_STARTING);
	sensor_says("$startack;\n");
	lpm(1);
	glider_says("STOP\r");
	sensor_says("$stopack;\n");
	fake_tx_clear();
	glider_says("SEND_TXT_FILE 2\r");
	zassert_equal(fake_count(PORT_GLIDER, "LPM,"), 1);
	zassert_not_null(strstr(fake_tx(PORT_GLIDER), "#SEG,2,climb,1,"));
}

ZTEST(seaglider, test_stop_when_idle_answers_at_once)
{
	sensor_says("HW_CONF\n");
	glider_says("STOP\r");
	zassert_equal(prompts(), 2);
	zassert_equal(fake_count(PORT_SENSOR, "$stop;"), 0);
}

ZTEST(seaglider, test_unknown_command)
{
	sensor_says("HW_CONF\n");
	glider_says("FOO\r");
	zassert_not_null(strstr(fake_tx(PORT_GLIDER), "?\r\n" PROMPT));
}

ZTEST(seaglider, test_no_banner_still_answers)
{
	/* Sensor already powered or silent: prompt after the boot timeout */
	advance_ms(CONFIG_SMART_SENSOR_BOOT_TIMEOUT_MS + 10);
	zassert_equal(prompts(), 1);
	glider_says("START 20260601,120000,1\r");
	zassert_equal(controller_state(), ST_STARTING);
}

#endif /* CONFIG_SMART_GLIDER_SEAGLIDER */
```

## src/test_scenario_slocum.c
```c
/*
 * End-to-end scenarios for the uvp6_slocum profile: scripted Backseat Driver
 * traffic in, exact bytes to the glider and to the UVP6 checked.
 */
#ifdef CONFIG_SMART_GLIDER_SLOCUM

#include <string.h>
#include <zephyr/ztest.h>

#include "core/app.h"
#include "core/controller.h"
#include "core/nav.h"
#include "fake_hw.h"

#define START_T0   "$start:ACQ_CSCS_002H,20090213,233130;\n"
#define START_NOT  "$start:ACQ_CSCS_002H;\n"
#define STOP       "$stop;\n"
#define LPM(depth) "LPM_DATA," depth ",20090213,233131,10,4.5,1,1,1,1,2,2,2,2,3,3,3,3,4,4,4,4,5,5;\n"

static void before(void *f)
{
	ARG_UNUSED(f);
	fake_reset();
	app_init(0);
}

ZTEST_SUITE(slocum, NULL, NULL, before, NULL, NULL);

static bool glider_got(const char *payload)
{
	return strstr(fake_tx(PORT_GLIDER), nmea_of(payload)) != NULL;
}

static void boot(void)
{
	sensor_says("HW_CONF,000001,UVP6\n");
	zassert_equal(controller_state(), ST_IDLE);
}

static void start_sampling(void)
{
	boot();
	glider_nmea("HI");
	glider_nmea("SD,4:1234567890,5:1.50,6:1");
	zassert_equal(controller_state(), ST_STARTING);
	sensor_says("$startack;\n");
	zassert_equal(controller_state(), ST_SAMPLING);
}

ZTEST(slocum, test_full_dive_cycle)
{
	boot();
	zassert_true(fake_sensor_powered());

	glider_nmea("HI");
	zassert_true(glider_got("SW,0:3"), "health on session start");
	zassert_equal(controller_state(), ST_ARMED, "waits for glider time");

	glider_nmea("SD,4:1234567890,5:1.50,6:1");
	zassert_equal(controller_state(), ST_STARTING);
	zassert_not_null(strstr(fake_tx(PORT_SENSOR), START_T0));

	sensor_says("$startack;\n");
	zassert_equal(controller_state(), ST_SAMPLING);
	zassert_true(glider_got("SW,1:1"), "started with time");

	sensor_says(LPM("10.50"));
	sensor_says(LPM("25.25"));
	sensor_says(LPM("20.00"));

	/* Dive -> climb: stop, report the leg, restart after the holdoff */
	fake_tx_clear();
	glider_nmea("SD,5:30.0,6:2");
	zassert_equal(controller_state(), ST_STOPPING);
	zassert_str_equal(fake_tx(PORT_SENSOR), STOP);
	sensor_says("$stopack;\n");
	zassert_equal(controller_state(), ST_HOLDOFF);
	zassert_true(glider_got("SW,0:11,2:3,3:25.25"), "got: %s", fake_tx(PORT_GLIDER));

	fake_tx_clear();
	advance_ms(2000);
	zassert_equal(controller_state(), ST_STARTING);
	/* glider time extrapolated by 2 s */
	zassert_not_null(strstr(fake_tx(PORT_SENSOR), "$start:ACQ_CSCS_002H,20090213,233132;\n"));
	sensor_says("$startack;\n");
	zassert_equal(controller_state(), ST_SAMPLING);

	/* End of the extctl sample state */
	glider_nmea("BY");
	zassert_equal(controller_state(), ST_STOPPING);
	sensor_says("$stopack;\n");
	zassert_equal(controller_state(), ST_IDLE);
}

ZTEST(slocum, test_starts_without_time_after_wait)
{
	boot();
	glider_nmea("HI");
	advance_ms(4990);
	zassert_equal(controller_state(), ST_ARMED);
	advance_ms(20);
	zassert_equal(controller_state(), ST_STARTING);
	zassert_str_equal(fake_tx(PORT_SENSOR), START_NOT);
	sensor_says("$startack;\n");
	zassert_true(glider_got("SW,1:-1"));
}

ZTEST(slocum, test_start_retries_then_backs_off)
{
	boot();
	glider_nmea("HI");
	glider_nmea("SD,4:1234567890,5:1.50,6:1");
	advance_ms(3000);
	zassert_equal(fake_count(PORT_SENSOR, "$start:"), 3, "1 try + 2 retries");
	zassert_equal(fake_count(PORT_SENSOR, STOP), 1, "safety stop");
	zassert_equal(controller_state(), ST_HOLDOFF);
	zassert_true(glider_got("SW,0:27"), "start-failed bit; got %s", fake_tx(PORT_GLIDER));

	fake_tx_clear();
	advance_ms(10000);
	zassert_equal(controller_state(), ST_STARTING, "retries after the backoff");
	sensor_says("LPM_DATA,5.0,x;\n"); /* data counts as a start ack */
	zassert_equal(controller_state(), ST_SAMPLING);
}

ZTEST(slocum, test_rejects_bad_checksums)
{
	boot();
	glider_says("$HI\r\n"); /* no checksum */
	zassert_equal(controller_state(), ST_IDLE);
	glider_says("$SD,4:1234567890,5:1.5,6:1*00\r\n");
	zassert_false(nav_get()->time_valid);
	zassert_true(controller_health() & BIT(6));
	zassert_equal(controller_state(), ST_IDLE);
}

ZTEST(slocum, test_sd_recovers_session_after_board_reset)
{
	boot();
	/* $HI was sent before this board rebooted; only $SD arrives */
	glider_nmea("SD,4:1234567890,5:40.0,6:1");
	zassert_equal(controller_state(), ST_STARTING);
}

ZTEST(slocum, test_stops_unattended_sensor)
{
	boot();
	sensor_says(LPM("10.0"));
	sensor_says(LPM("11.0"));
	zassert_equal(fake_count(PORT_SENSOR, STOP), 1);
}

ZTEST(slocum, test_restarts_after_sensor_reboot)
{
	start_sampling();
	fake_tx_clear();
	sensor_says("HW_CONF,000001,UVP6\n");
	zassert_equal(controller_state(), ST_STOPPING);
	sensor_says("$stopack;\n");
	advance_ms(2000);
	zassert_equal(controller_state(), ST_STARTING);
	zassert_equal(fake_count(PORT_SENSOR, "$start:"), 1);
}

ZTEST(slocum, test_stop_without_ack_gives_up)
{
	start_sampling();
	fake_tx_clear();
	glider_nmea("BY");
	advance_ms(4000);
	zassert_equal(fake_count(PORT_SENSOR, STOP), 4, "1 try + 3 retries");
	zassert_equal(controller_state(), ST_IDLE);
}

ZTEST(slocum, test_passthrough)
{
	boot();
	glider_says("$MIRROR\r\n");
	zassert_equal(controller_state(), ST_PASSTHROUGH);
	fake_tx_clear();
	glider_says("$hello;\n");
	sensor_says("$hi back;\n");
	zassert_str_equal(fake_tx(PORT_SENSOR), "$hello;\n");
	zassert_str_equal(fake_tx(PORT_GLIDER), "$hi back;\n");
	glider_says("$QUIT\r\n");
	zassert_equal(controller_state(), ST_IDLE);
}

ZTEST(slocum, test_passthrough_times_out)
{
	boot();
	glider_says("$MIRROR\r\n");
	advance_ms(CONFIG_SMART_PASSTHROUGH_TIMEOUT_S * 1000 + 10);
	zassert_equal(controller_state(), ST_IDLE);
}

#endif /* CONFIG_SMART_GLIDER_SLOCUM */
```

## src/test_util.c
```c
/* Unit tests for the protocol and formatting helpers. */
#include <errno.h>
#include <string.h>
#include <zephyr/ztest.h>

#include "core/linebuf.h"
#include "core/store.h"
#include "util/fmt.h"
#include "util/nmea.h"
#include "util/strutil.h"
#include "util/template.h"
#include "util/timeutil.h"

ZTEST_SUITE(util, NULL, NULL, NULL, NULL, NULL);

ZTEST(util, test_nmea_checksum_matches_bsd_manual)
{
	/* Examples from the G3S Backseat Driver guide, chapter 4 */
	zassert_equal(nmea_checksum("SW,0:4.000000", 13), 0x38);
	zassert_equal(nmea_checksum("SW,0:0.12,1:508.0", 17), 0x3B);
}

ZTEST(util, test_nmea_build_and_parse)
{
	char out[64];
	struct nmea_frame f;

	zassert_equal(nmea_build(out, sizeof(out), "SW,0:4.000000"), 19);
	zassert_str_equal(out, "$SW,0:4.000000*38\r\n");

	zassert_ok(nmea_parse("$SD,4:1234567890.0,5:12.5*7B", &f));
	zassert_true(nmea_type_is(&f, "SD"));
	zassert_equal(f.fields_len, strlen("4:1234567890.0,5:12.5"));

	nmea_build(out, sizeof(out), "SD,4:1234567890.0,5:12.5");
	out[strlen(out) - 2] = '\0'; /* strip CRLF */
	zassert_ok(nmea_parse(out, &f));
	zassert_equal(f.cs, NMEA_CS_OK);

	out[1] = 'X'; /* corrupt one character */
	zassert_ok(nmea_parse(out, &f));
	zassert_equal(f.cs, NMEA_CS_BAD);

	zassert_ok(nmea_parse("$HI", &f));
	zassert_equal(f.cs, NMEA_CS_ABSENT);
	zassert_true(nmea_type_is(&f, "HI"));

	zassert_equal(nmea_parse("HI*00", &f), -EINVAL);
	zassert_equal(nmea_parse("$", &f), -EINVAL);
}

struct pairs {
	int idx[8];
	char val[8][32];
	int n;
};

static void collect(int idx, const char *value, void *user)
{
	struct pairs *p = user;

	p->idx[p->n] = idx;
	strcpy(p->val[p->n], value);
	p->n++;
}

ZTEST(util, test_nmea_pairs)
{
	struct pairs p = {0};
	const char *body = "4:1234.5,5:-3,bogus,7:,:9,6:1";
	int bad = nmea_for_each_pair(body, strlen(body), collect, &p);

	zassert_equal(p.n, 3);
	zassert_equal(bad, 3);
	zassert_equal(p.idx[0], 4);
	zassert_str_equal(p.val[0], "1234.5");
	zassert_equal(p.idx[1], 5);
	zassert_str_equal(p.val[1], "-3");
	zassert_equal(p.idx[2], 6);
}

ZTEST(util, test_time_conversion)
{
	struct civil_time ct;

	epoch_to_civil(1234567890, &ct);
	zassert_equal(ct.year, 2009);
	zassert_equal(ct.month, 2);
	zassert_equal(ct.day, 13);
	zassert_equal(ct.hour, 23);
	zassert_equal(ct.min, 31);
	zassert_equal(ct.sec, 30);
	zassert_equal(civil_to_epoch(&ct), 1234567890);

	zassert_true(civil_parse_compact("20240229", "235959", &ct));
	zassert_equal(civil_to_epoch(&ct), 1709251199);
	zassert_false(civil_parse_compact("2024022", "235959", &ct));
	zassert_false(civil_parse_compact("20241301", "000000", &ct));
}

ZTEST(util, test_template)
{
	char out[96];
	struct tmpl_ctx ctx = {.have_time = true, .epoch = 1234567890};

	zassert_equal(tmpl_expand("$start:ACQ_CSCS_002H,%Y%m%d,%H%M%S;%n", &ctx, out,
				  sizeof(out)),
		      38);
	zassert_str_equal(out, "$start:ACQ_CSCS_002H,20090213,233130;\n");

	ctx.have_time = false;
	zassert_equal(tmpl_expand("%Y", &ctx, out, sizeof(out)), -ENODATA);
	zassert_equal(tmpl_expand("%D", &ctx, out, sizeof(out)), -ENODATA);
	ctx.have_depth = true;
	ctx.depth = -1.0075;
	ctx.cast = 2;
	zassert_true(tmpl_expand("D=%D c=%c 100%%%r", &ctx, out, sizeof(out)) > 0);
	zassert_str_equal(out, "D=-1.01 c=2 100%\r");
	zassert_equal(tmpl_expand("%q", &ctx, out, sizeof(out)), -EINVAL);
	zassert_equal(tmpl_expand("abcdef", &ctx, out, 4), -ENOSPC);

	zassert_true(tmpl_needs_time("x%Hy"));
	zassert_false(tmpl_needs_time("%%H %D"));
}

ZTEST(util, test_fmt_fixed)
{
	char out[24];

	fmt_fixed(out, sizeof(out), 25.255, 2);
	zassert_str_equal(out, "25.26");
	fmt_fixed(out, sizeof(out), -0.004, 2);
	zassert_str_equal(out, "0.00");
	fmt_fixed(out, sizeof(out), -3.5, 0);
	zassert_str_equal(out, "-4");
	fmt_fixed(out, sizeof(out), 7, 3);
	zassert_str_equal(out, "7.000");
}

static int feed(struct linebuf *lb, const char *s, char lines[][32])
{
	int n = 0;

	for (; *s; s++) {
		if (linebuf_feed(lb, *s, 0)) {
			strcpy(lines[n++], lb->buf);
		}
	}
	return n;
}

ZTEST(util, test_linebuf)
{
	char mem[8];
	char lines[8][32];
	struct linebuf lb;

	linebuf_init(&lb, mem, sizeof(mem));
	zassert_equal(feed(&lb, "ab\r\ncd\n\n\re\r", lines), 3);
	zassert_str_equal(lines[0], "ab");
	zassert_str_equal(lines[1], "cd");
	zassert_str_equal(lines[2], "e");

	/* Overflow: the long line is dropped, the next one survives */
	zassert_equal(feed(&lb, "0123456789\nok\n", lines), 1);
	zassert_str_equal(lines[0], "ok");
	zassert_equal(lb.overflows, 1);

	/* logdev wake-up: a bare CR is a line, CRLF is one line not two */
	lb.emit_empty = true;
	zassert_equal(feed(&lb, "\r", lines), 1);
	zassert_str_equal(lines[0], "");
	zassert_equal(feed(&lb, "go\r\n", lines), 1);

	/* A partial line is taken after it goes idle */
	linebuf_feed(&lb, 'S', 100);
	linebuf_feed(&lb, '>', 100);
	zassert_false(linebuf_take_idle(&lb, 200, 300));
	zassert_true(linebuf_take_idle(&lb, 400, 300));
	zassert_str_equal(lb.buf, "S>");
}

static void append_out(const char *data, size_t len, void *user)
{
	strncat(user, data, len);
	strcat(user, "|");
}

ZTEST(util, test_store_partitions)
{
	char out[256] = "";

	store_init();
	store_append(1, "dive-a");
	store_append(2, "climb-a");
	store_append(1, "dive-b");
	store_dump(1, append_out, out);
	zassert_str_equal(out, "dive-a|dive-b|");

	store_clear(1);
	out[0] = '\0';
	store_dump(-1, append_out, out);
	zassert_str_equal(out, "climb-a|");
	zassert_equal(store_used(), strlen("2climb-a\n"));
}

ZTEST(util, test_keyword)
{
	const char *rest;

	zassert_true(str_keyword("START 20260101,000000,1", "START", &rest));
	zassert_str_equal(rest, "20260101,000000,1");
	zassert_true(str_keyword("stop", "STOP", NULL));
	zassert_false(str_keyword("STOPPED", "STOP", NULL));
	zassert_true(str_keyword("DEPTH:12.5", "DEPTH:", &rest));
	zassert_str_equal(rest, "12.5");
	zassert_true(str_keyword("$MIRROR*12", "$MIRROR", NULL));
}
```
